## boards/shields/arnoll-rhythmboard-1/Kconfig.defconfig
```kconfig
if SHIELD_ARNOLL_RHYTHMBOARD_1

# Name must be less than 16 characters long!
config ZMK_KEYBOARD_NAME
    default "Arnoll Rhythmboard 1"

# config SPI
#     default y
# https://zmk.dev/docs/development/hardware-integration/shift-registers
# https://github.com/petejohanson/revxlp-config/blob/main/config/boards/shields/revxlp/Kconfig.defconfig

config ZMK_HID_REPORT_TYPE_NKRO
    bool
    default y

# config BT
#     bool
#     default y

# config ZMK_BLE
#     bool
#     default y

# config USB
#     bool
#     default y

config ZMK_USB
    bool
    default y


# CONFIG_ZMK_HID_REPORT_TYPE_NKRO=y
#CONFIG_BT=y
#CONFIG_ZMK_BLE=y
#CONFIG_USB=y
#CONFIG_ZMK_USB=y

endif
```

## boards/shields/arnoll-rhythmboard-1/Kconfig.shield
```kconfig
config ARNOLL_RHYTHMBOARD_1
    def_bool $(shields_list_contains,arnoll-rhythmboard-1)
```

## boards/shields/arnoll-rhythmboard-1/arnoll-rhythmboard-1_defconfig
```kconfig
CONFIG_ZMK_HID_REPORT_TYPE_NKRO=y
# From the instruction of https://github.com/KinesisCorporation/Adv360-Pro-ZMK#n-key-rollover
```
